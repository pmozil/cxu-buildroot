## package/cxu-tfmicro-demo/Config.in
```kconfig
config BR2_PACKAGE_CXU_TFMICRO_DEMO
	bool "cxu-tflite-demo"
	depends on BR2_INSTALL_LIBSTDCPP
	help
	  A custom C++ AI application running inference via TFLite Micro.
```

## package/cxu_tests/Config.in
```kconfig
config BR2_PACKAGE_CXU_TEST
	bool "cxu_test"
	help
	  'cxu_test' is a set of tests to validate whether the cxu_test
	  works in the intended way.
```

## package/gzip_cxu/Config.in
```kconfig
config BR2_PACKAGE_GZIP_CXU
	bool "gzip_cxu"
	depends on BR2_USE_WCHAR
	depends on BR2_PACKAGE_BUSYBOX_SHOW_OTHERS
	help
	  Standard GNU compressor with the CXU extension for gzip.
	  Provides things like gzip,
	  gunzip, gzcat, etc...

	  http://www.gnu.org/software/gzip/gzip.html

comment "gzip_cxu needs a toolchain w/ wchar"
	depends on !BR2_USE_WCHAR
	depends on BR2_PACKAGE_BUSYBOX_SHOW_OTHERS
```

## package/python-pytorch/Config.in
```kconfig
config BR2_PACKAGE_PYTORCH
    bool "pytorch"
    depends on BR2_PACKAGE_PYTHON3
    select BR2_PACKAGE_PYTHON_NUMPY
```

## package/tflite-micro/Config.in
```kconfig
config BR2_PACKAGE_TFLITE_MICRO
	bool "tflite-micro"
	depends on BR2_INSTALL_LIBSTDCPP
	help
	  TensorFlow Lite for Microcontrollers.

	  https://github.com/tensorflow/tflite-micro

comment "tflite-micro needs a toolchain w/ C++"
	depends on !BR2_INSTALL_LIBSTDCPP
```
